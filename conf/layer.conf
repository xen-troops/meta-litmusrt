## conf/layer.conf
```bitbake
# We have a conf and classes directory, add to BBPATH
BBPATH .= ":${LAYERDIR}"

# We have recipes-* directories, add to BBFILES
BBFILES += "${LAYERDIR}/recipes-*/*/*.bb \
	${LAYERDIR}/recipes-*/*/*.bbappend"

BBFILE_COLLECTIONS += "litmusrt"
BBFILE_PATTERN_litmusrt = "^${LAYERDIR}/"
BBFILE_PRIORITY_litmusrt = "6"
```

## conf/machine/genericarmv8.conf
```bitbake
#@TYPE: Machine
#@NAME: generic armv8 machine
#@DESCRIPTION: generic machine to be used by litmusrt-image-minimal

require conf/machine/include/arm/arch-armv8.inc

MACHINE_FEATURES = ""

KERNEL_IMAGETYPE = "Image"

PREFERRED_PROVIDER_virtual/kernel = "linux-litmusrt"

SERIAL_CONSOLE ?= "115200 hvc0"
```
